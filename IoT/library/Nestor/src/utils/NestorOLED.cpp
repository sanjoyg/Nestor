#include <Wire.h>
#include <utils/NestorOLED.h>
#include <Arduino.h>

const char myFont[][8] PROGMEM = {  
{0x00,0x00,0x00,0x00,0x00,0x00,0x00,0x00},
{0x00,0x00,0x5F,0x00,0x00,0x00,0x00,0x00},
{0x00,0x00,0x07,0x00,0x07,0x00,0x00,0x00},
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{0x00,0x02,0x05,0x05,0x02,0x00,0x00,0x00} 
};

#define offset 0x02   
#define OLED_address 0x3c 
#define MAX_LINES 7
#define MAX_CHARS 16

char NestorOLED::_data[17*8];
int  NestorOLED::_line = 0;


/*
*  0               F
*   1017889  IP:.192
*   12/27-08:03 W M
*   Normal log msg1
*   Normal log msg2
*/
void NestorOLED::print(const char *str) {
  if (_line > 6) {
    memcpy(_data,_data+17,17*7);
  } else {
    _line++;
  }
  
  strcpy(_data+17*_line,"................");

  int lenToCopy = strlen(str);
  if (lenToCopy>16) lenToCopy = 16;

  memcpy(_data+17*_line,str,lenToCopy);

  for (int i=0;i<=_line;i++) {
    NestorOLED::sendStrXY(_data+17*i,i,0);
  }
}

void NestorOLED::print(const __FlashStringHelper *line) {
   char buffer[17];
   memcpy(buffer,0x00,sizeof(buffer));
   PGM_P p = reinterpret_cast<PGM_P>(line);
    for (int index =0; index<17; index++) {
        uint8_t c = pgm_read_byte(p++);
        if (c == 0) break;
        buffer[index]=(char)c;
    }
    print(buffer);
}

// Resets display depending on the actual mode.
void NestorOLED::resetDisplay()
{
  displayOff();
  clearDisplay();
  displayOn();
  memset(_data,0x00,sizeof(_data));
}

//==========================================================//
// Turns display on.
void NestorOLED::displayOn()
{
  sendCommand(0xaf);        //display on
}

//==========================================================//
// Turns display off.
void NestorOLED::displayOff()
{
  sendCommand(0xae);    //display off
}

//==========================================================//
// Clears the display by sendind 0 to all the screen map.
void NestorOLED::clearDisplay(void)
{
  unsigned char i,k;
  for(k=0;k<8;k++)
  { 
    setXY(k,0);    
    {
      for(i=0;i<(128 + 2 * offset);i++)     //locate all COL
      {
        sendChar(0);         //clear all COL
        //delay(10);
      }
    }
  }
  memset(_data,0x00,sizeof(_data));
}

//==========================================================//
// Actually this sends a byte, not a char to draw in the display. 
// Display's chars uses 8 byte font the small ones and 96 bytes
// for the big number font.
void NestorOLED::sendChar(unsigned char data) 
{
  //if (interrupt && !doing_menu) return;   // Stop printing only if interrupt is call but not in button functions
  
  Wire.beginTransmission(OLED_address); // begin transmitting
  Wire.write(0x40);//data mode
  Wire.write(data);
  Wire.endTransmission();    // stop transmitting
}

//==========================================================//
// Prints a display char (not just a byte) in coordinates X Y,
// being multiples of 8. This means we have 16 COLS (0-15) 
// and 8 ROWS (0-7).
void NestorOLED::sendCharXY(unsigned char data, int X, int Y)
{
  setXY(X, Y);
  Wire.beginTransmission(OLED_address); // begin transmitting
  Wire.write(0x40);//data mode
  
  for(int i=0;i<8;i++)          
    Wire.write(pgm_read_byte(myFont[data-0x20]+i));
    
  Wire.endTransmission();    // stop transmitting
}

//==========================================================//
// Used to send commands to the display.
void NestorOLED::sendCommand(unsigned char com)
{
  Wire.beginTransmission(OLED_address);     //begin transmitting
  Wire.write(0x80);                          //command mode
  Wire.write(com);
  Wire.endTransmission();                    // stop transmitting
}

//==========================================================//
// Set the cursor position in a 16 COL * 8 ROW map.
void NestorOLED::setXY(unsigned char row,unsigned char col)
{
  sendCommand(0xb0+row);                //set page address
  sendCommand(offset+(8*col&0x0f));       //set low col address
  sendCommand(0x10+((8*col>>4)&0x0f));  //set high col address
}


//==========================================================//
// Prints a string regardless the cursor position.
void NestorOLED::sendStr(unsigned char *string)
{
  unsigned char i=0;
  while(*string)
  {
    for(i=0;i<8;i++)
    {
      sendChar(pgm_read_byte(myFont[*string-0x20]+i));
    }
    *string++;
  }
}

//==========================================================//
// Prints a string in coordinates X Y, being multiples of 8.
// This means we have 16 COLS (0-15) and 8 ROWS (0-7).
void NestorOLED::sendStrXY( const char *string, int X, int Y)
{
  setXY(X,Y);
  unsigned char i=0;
  while(*string)
  {
    for(i=0;i<8;i++)
    {
      sendChar(pgm_read_byte(myFont[*string-0x20]+i));
    }
    *string++;
  }
}


//==========================================================//
// Inits oled and draws logo at startup
void NestorOLED::init(void)
{
    _line = 0;
    Wire.begin(0,2);
    sendCommand(0xae);            //display off
    sendCommand(0xa6);            //Set Normal Display (default)
    // Adafruit Init sequence for 128x64 OLED module
    sendCommand(0xAE);             //DISPLAYOFF
    sendCommand(0xD5);            //SETDISPLAYCLOCKDIV
    sendCommand(0x80);            // the suggested ratio 0x80
    sendCommand(0xA8);            //SSD1306_SETMULTIPLEX
    sendCommand(0x3F);
    sendCommand(0xD3);            //SETDISPLAYOFFSET
    sendCommand(0x0);             //no offset
    sendCommand(0x40 | 0x0);      //SETSTARTLINE
    sendCommand(0x8D);            //CHARGEPUMP
    sendCommand(0x14);
    sendCommand(0x20);             //MEMORYMODE
    sendCommand(0x00);             //0x0 act like ks0108
    
    //sendCommand(0xA0 | 0x1);     //SEGREMAP   //Rotate screen 180 deg
    sendCommand(0xA0);
    
    sendCommand(0xC0);
    
    sendCommand(0xDA);            //0xDA
    sendCommand(0x12);            //COMSCANDEC
    sendCommand(0x81);            //SETCONTRAS
    sendCommand(0xCF);            //
    sendCommand(0xd9);            //SETPRECHARGE 
    sendCommand(0xF1); 
    sendCommand(0xDB);            //SETVCOMDETECT                
    sendCommand(0x40);
    sendCommand(0xA4);            //DISPLAYALLON_RESUME        
    sendCommand(0xA6);            //NORMALDISPLAY             

    clearDisplay();
    sendCommand(0x2e);            // stop scroll
    //----------------------------REVERSE comments----------------------------//
    sendCommand(0xa0);    //seg re-map 0->127(default)
    sendCommand(0xa1);    //seg re-map 127->0
    sendCommand(0xc8);
    delay(1000);
    //----------------------------REVERSE comments----------------------------//
    // sendCommand(0xa7);  //Set Inverse Display  
    // sendCommand(0xae);   //display off
    sendCommand(0x20);            //Set Memory Addressing Mode
    sendCommand(0x00);            //Set Memory Addressing Mode ab Horizontal addressing mode
    //  sendCommand(0x02);         // Set Memory Addressing Mode ab Page addressing mode(RESET)  
}